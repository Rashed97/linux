## drivers/net/wireless/mediatek/mt76/mt7927/Kconfig
```kconfig
# SPDX-License-Identifier: ISC
config MT7927_COMMON
	tristate
	select MT792x_LIB
	select WANT_DEV_COREDUMP

config MT7927E
	tristate "MediaTek MT7927E (PCIe) support"
	select MT7927_COMMON
	depends on MAC80211
	depends on PCI
	help
	  This adds support for MT7927-based wireless PCIe devices,
	  which support operation at 6GHz, 5GHz, and 2.4GHz IEEE 802.11be
	  2x2:2SS 4096-QAM, 320MHz channels.

	  To compile this driver as a module, choose M here.

config MT7927U
	tristate "MediaTek MT7927U (USB) support"
	select MT792x_USB
	select MT7927_COMMON
	depends on MAC80211
	depends on USB
	help
	  This adds support for MT7927-based wireless USB devices,
	  which support operation at 6GHz, 5GHz, and 2.4GHz IEEE 802.11be
	  2x2:2SS 4096-QAM, 320MHz channels.

	  To compile this driver as a module, choose M here.
```

## drivers/pinctrl/tegra/Kconfig
```kconfig
# SPDX-License-Identifier: GPL-2.0-only
config PINCTRL_TEGRA
	tristate
	select PINMUX
	select PINCONF

config PINCTRL_TEGRA20
	tristate
	select PINCTRL_TEGRA

config PINCTRL_TEGRA30
	tristate
	select PINCTRL_TEGRA

config PINCTRL_TEGRA114
	tristate
	select PINCTRL_TEGRA

config PINCTRL_TEGRA124
	tristate
	select PINCTRL_TEGRA

config PINCTRL_TEGRA210
	tristate
	select PINCTRL_TEGRA

config PINCTRL_TEGRA186
	tristate
	select PINCTRL_TEGRA

config PINCTRL_TEGRA194
	tristate
	select PINCTRL_TEGRA

config PINCTRL_TEGRA_XUSB
	tristate
	default y if ARCH_TEGRA
	select GENERIC_PHY
	select PINCONF
	select PINMUX
```

## drivers/reset/tegra/Kconfig
```kconfig
# SPDX-License-Identifier: GPL-2.0-only
config RESET_TEGRA_BPMP
	def_tristate TEGRA_BPMP
```
